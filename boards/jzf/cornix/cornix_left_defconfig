## boards/jzf/cornix/cornix_left_defconfig
```kconfig
CONFIG_ADC_NRFX_SAADC=y
CONFIG_ARM_MPU=y
CONFIG_BT_CTLR_TX_PWR_PLUS_8=y
CONFIG_BT_MAX_CONN=6
CONFIG_BT_MAX_PAIRED=6
CONFIG_BUILD_OUTPUT_UF2=y
CONFIG_CLOCK_CONTROL_NRF=y
CONFIG_CLOCK_CONTROL_NRF_K32SRC_RC=y
CONFIG_EC11=y
CONFIG_EC11_TRIGGER_GLOBAL_THREAD=y
CONFIG_FLASH=y
CONFIG_FLASH_MAP=y
CONFIG_FLASH_PAGE_LAYOUT=y
CONFIG_GPIO=y
CONFIG_MPU_ALLOW_FLASH_WRITE=y
CONFIG_NVS=y
CONFIG_PINCTRL=y
CONFIG_PINCTRL=y
CONFIG_SETTINGS_NVS=y
CONFIG_SPI=n
CONFIG_USE_DT_CODE_PARTITION=y
CONFIG_ZMK_BATTERY_REPORT_INTERVAL=60
CONFIG_ZMK_BLE_CLEAR_BONDS_ON_START=n
CONFIG_ZMK_BLE_PASSKEY_ENTRY=n
CONFIG_ZMK_DISPLAY=n
CONFIG_ZMK_HID_REPORT_TYPE_NKRO=n
CONFIG_ZMK_KEYBOARD_NAME="Cornix"
CONFIG_ZMK_POINTING=y
CONFIG_ZMK_SPLIT=y
CONFIG_ZMK_SPLIT_BLE_CENTRAL_BATTERY_LEVEL_FETCHING=y
CONFIG_ZMK_SPLIT_BLE_CENTRAL_BATTERY_LEVEL_PROXY=y
CONFIG_ZMK_SPLIT_ROLE_CENTRAL=y
CONFIG_ZMK_STUDIO=y
CONFIG_ZMK_STUDIO_LOCKING=n
CONFIG_ZMK_STUDIO_LOCK_ON_DISCONNECT=n
CONFIG_ZMK_USB=y
```

## boards/jzf/cornix/cornix_right_defconfig
```kconfig
CONFIG_ADC_NRFX_SAADC=y
CONFIG_ARM_MPU=y
CONFIG_BUILD_OUTPUT_UF2=y
CONFIG_CLOCK_CONTROL_NRF=y
CONFIG_CLOCK_CONTROL_NRF_K32SRC_RC=y
CONFIG_EC11=y
CONFIG_EC11_TRIGGER_GLOBAL_THREAD=y
CONFIG_FLASH=y
CONFIG_FLASH_MAP=y
CONFIG_FLASH_PAGE_LAYOUT=y
CONFIG_GPIO=y
CONFIG_INPUT=y
CONFIG_MPU_ALLOW_FLASH_WRITE=y
CONFIG_NVS=y
CONFIG_PINCTRL=y
CONFIG_SETTINGS_NVS=y
CONFIG_USE_DT_CODE_PARTITION=y
CONFIG_ZMK_BLE=y
CONFIG_ZMK_SPLIT=y
CONFIG_ZMK_USB=n
#CONFIG_SPI=n
#CONFIG_ZMK_EXT_POWER=n
```
