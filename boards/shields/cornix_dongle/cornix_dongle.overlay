#include "../../jzf/cornix/cornix_dongle_common.dtsi"
//vim: set ft=dts:

/*
|--R--|--_--|--Y--|--_--|--G--|
|---20|---40|---60|---80|--100|

┌───────┬─────────┬─────┬─────┬─────┐
│ Value │  Color  │  R  │  G  │  B  │
├───────┼─────────┼─────┼─────┼─────┤
│ 0     │ Black   │ 0   │ 0   │ 0   │ // #FFFFFF - USB
│ 1     │ Red     │ 255 │ 0   │ 0   │ // #FF0000 - BAT_LOW
│ 2     │ Green   │ 0   │ 255 │ 0   │ // #00FF00 - BAT_HIGH
│ 3     │ Yellow  │ 255 │ 255 │ 0   │ // #FFFF00 - BAT_MID
│ 4     │ Blue    │ 0   │ 0   │ 255 │ // #0000FF - BT
│ 5     │ Magenta │ 255 │ 0   │ 255 │ // #FF00FF
│ 6     │ Cyan    │ 0   │ 255 │ 255 │ // #00FFFF
│ 7     │ White   │ 255 │ 255 │ 255 │ // #FFFFFF
└───────┴─────────┴─────┴─────┴─────┘

indicate-battery     : ind_bat
indicate-connectivity: ind_con
indicate-layer       : ind_lyr
*/
