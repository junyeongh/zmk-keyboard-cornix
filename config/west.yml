## config/west.yml
```yaml
manifest:
  remotes:
    - name: zmkfirmware
      url-base: https://github.com/zmkfirmware
    - name: caksoylar
      url-base: https://github.com/caksoylar
    - name: englmaxi
      url-base: https://github.com/englmaxi
    - name: hitsmaxft
      url-base: https://github.com/hitsmaxft
  projects:
    - name: zmk
      remote: zmkfirmware
      revision: main
      clone-depth: 1
      import:
        file: app/west.yml
    - name: zmk-rgbled-widget
      remote: caksoylar # caksoylar
      revision: main
    - name: zmk-dongle-display
      remote: englmaxi
      revision: main
      clone-depth: 1
  self:
    path: config
```
